## config/boards/shields/perosweep1/Kconfig.shield
```kconfig
# Copyright (c) 2020 The ZMK Contributors
# SPDX-License-Identifier: MIT

config SHIELD_PEROSWEEP1_LEFT
	def_bool $(shields_list_contains,perosweep1_left)

config SHIELD_PEROSWEEP1_RIGHT
	def_bool $(shields_list_contains,perosweep1_right)
```
