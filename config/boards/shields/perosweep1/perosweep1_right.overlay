/*
 * Copyright (c) 2020 The ZMK Contributors
 *
 * SPDX-License-Identifier: MIT
 */

#include "perosweep1.dtsi"

&default_transform {
	col-offset = <17>;
};

/*  The Mechboards UK board has some pin layout changes.
    Since they only provide a QMK firmware, we try to
    map the changes from the QMK firmware to ZMK.

    This is the default QMK layout:
    (https://github.com/qmk/qmk_firmware/blob/10631b4b480c618c72b4c6b908025f2408e15f5b/keyboards/ferris/sweep/config.h)

    #define DIRECT_PINS_RIGHT { \
        { F4, F5, F6, F7, E6 }, \
        { D3, B6, B2, B3, B1 }, \
        { D7, C6, D4, D0, D1 }, \
        { B5, B4, NO_PIN, NO_PIN, NO_PIN } \
    }

    This is the Mechboards layout:
    (https://github.com/qmk/qmk_firmware/blob/10631b4b480c618c72b4c6b908025f2408e15f5b/keyboards/ferris/sweep_choc_mbuk/config.h)

    #define DIRECT_PINS_RIGHT { \
        { F4, F5, F6, F7, D7 }, \
        { D1, D3, B2, B3, B1 }, \
        { B4, E6, C6, B5, D0 }, \
        { D4, B6, NO_PIN, NO_PIN, NO_PIN } \
    }

    This reference didn't help at all (in contrast to the left side).
    In the end, I had to figure out the mapping via trial and error.

*/

/ {
	kscan0: kscan {
		compatible = "zmk,kscan-gpio-direct";
		label = "KSCAN";
        input-gpios
        = <&pro_micro  6 (GPIO_ACTIVE_LOW | GPIO_PULL_UP)> // f
        , <&pro_micro 18 (GPIO_ACTIVE_LOW | GPIO_PULL_UP)> // g
        , <&pro_micro 19 (GPIO_ACTIVE_LOW | GPIO_PULL_UP)> // c
        , <&pro_micro 20 (GPIO_ACTIVE_LOW | GPIO_PULL_UP)> // r
        , <&pro_micro 21 (GPIO_ACTIVE_LOW | GPIO_PULL_UP)> // l

        , <&pro_micro 15 (GPIO_ACTIVE_LOW | GPIO_PULL_UP)> // s
        , <&pro_micro 14 (GPIO_ACTIVE_LOW | GPIO_PULL_UP)> // n
        , <&pro_micro 16 (GPIO_ACTIVE_LOW | GPIO_PULL_UP)> // t
        , <&pro_micro 10 (GPIO_ACTIVE_LOW | GPIO_PULL_UP)> // backspace
        , <&pro_micro  2 (GPIO_ACTIVE_LOW | GPIO_PULL_UP)> // h 

        , <&pro_micro  3 (GPIO_ACTIVE_LOW | GPIO_PULL_UP)> // z
        , <&pro_micro  9 (GPIO_ACTIVE_LOW | GPIO_PULL_UP)> // v
        , <&pro_micro  5 (GPIO_ACTIVE_LOW | GPIO_PULL_UP)> // enter 
        , <&pro_micro  7 (GPIO_ACTIVE_LOW | GPIO_PULL_UP)> // m 
        , <&pro_micro  8 (GPIO_ACTIVE_LOW | GPIO_PULL_UP)> // b

        , <&pro_micro  1 (GPIO_ACTIVE_LOW | GPIO_PULL_UP)> // d
        , <&pro_micro  4 (GPIO_ACTIVE_LOW | GPIO_PULL_UP)> // w
        ;
    };
};
